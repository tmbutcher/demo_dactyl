## boards/shields/demo_dactyl/Kconfig.defconfig
```kconfig
if SHIELD_DEMO_DACTYL_LEFT

# Name must be less than 16 characters long!
config ZMK_KEYBOARD_NAME
    default "Demo_Dactyl"

config ZMK_SPLIT
    default y

config ZMK_SPLIT_ROLE_CENTRAL
    default y

endif

if SHIELD_DEMO_DACTYL_RIGHT

# Name must be less than 16 characters long!
config ZMK_KEYBOARD_NAME
    default "Demo_Dactyl R"

config ZMK_SPLIT
    default y

endif
```

## boards/shields/demo_dactyl/Kconfig.shield
```kconfig
config SHIELD_DEMO_DACTYL_LEFT
    def_bool $(shields_list_contains,demo_dactyl_left)

config SHIELD_DEMO_DACTYL_RIGHT
    def_bool $(shields_list_contains,demo_dactyl_right)
```

## config/west.yml
```yaml
manifest:
  
  defaults:
    revision: main
  
  remotes:
    - name: zmkfirmware
      url-base: https://github.com/zmkfirmware
    
    - name: urob
      url-base: https://github.com/urob
  
  projects:
    - name: zmk
      remote: zmkfirmware
      import: app/west.yml

    # Modules
    - name: zmk-helpers
      remote: urob
      # revision: main
    - name: zmk-unicode
      remote: urob
      # revision: main
    - name: zmk-auto-layer
      remote: urob
      # revision: main

  self:
    path: config
```
